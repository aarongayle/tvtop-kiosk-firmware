// The screens the firmware draws itself. The wifi-setup screen is the interesting one: its body is
// composed at runtime from two lists of network names, so it is the one screen whose text can be
// any length — and centred text that is wider than the canvas runs off both edges of the
// television, where nobody can read either end of it.
#include <stdio.h>
#include <stdlib.h>
#include <string.h>
#include "builtin_frames.h"
#include "font.h"

static int failures;
#define CHECK(cond) do { if (!(cond)) { failures++; printf("FAIL %s:%d: %s\n", __FILE__, __LINE__, #cond); } } while (0)
#define CHECK_MSG(cond, ...) do { if (!(cond)) { failures++; printf("FAIL %s:%d: ", __FILE__, __LINE__); printf(__VA_ARGS__); printf("\n"); } } while (0)

#define CANVAS_W 1280
#define MAX_TEXT_W 1100     // must match builtin_frames.c's STACK_MAX_W

typedef struct { int x, y, size; char text[256]; } text_op_t;

// Pulls every ["t",x,y,"...",size,...] op out of a built-in frame. The frames are generated by
// snprintf from fixed templates, so a scan for the op tag is enough and saves dragging the whole
// decoder in here.
static int text_ops(const char *json, text_op_t *out, int max) {
    int n = 0;
    for (const char *p = strstr(json, "[\"t\","); p && n < max; p = strstr(p + 1, "[\"t\",")) {
        const char *q = p + 5;
        text_op_t t = {0};
        t.x = atoi(q);
        q = strchr(q, ','); if (!q) break;
        t.y = atoi(++q);
        q = strchr(q, ','); if (!q) break;
        if (*++q != '"') break;
        size_t i = 0;
        for (q++; *q && *q != '"' && i + 1 < sizeof t.text; q++) {
            if (*q == '\\' && q[1]) q++;      // no escapes in these cases; do not stop on one
            t.text[i++] = *q;
        }
        t.text[i] = 0;
        if (*q != '"') break;
        t.size = atoi(q + 2);
        out[n++] = t;
    }
    return n;
}

static int width_px(const text_op_t *t) {
    return (int)((font_measure(t->text, strlen(t->text), t->size, false) + 4) >> 3);
}

// Every centred line must fit the canvas with room to spare, and the lines must step downwards
// without landing on the fixed text at the bottom of the screen.
static void check_fits(const char *what, const char *json, int floor_y) {
    text_op_t ops[32];
    int n = text_ops(json, ops, 32);
    CHECK_MSG(n > 0, "%s: no text ops", what);
    for (int i = 0; i < n; i++) {
        int w = width_px(&ops[i]);
        int left = ops[i].x - w / 2, right = ops[i].x + w / 2;
        CHECK_MSG(left >= 0 && right <= CANVAS_W, "%s: \"%s\" spans %d..%d of %d px",
                  what, ops[i].text, left, right, CANVAS_W);
        CHECK_MSG(ops[i].y <= floor_y, "%s: \"%s\" sits at y=%d, below %d",
                  what, ops[i].text, ops[i].y, floor_y);
    }
}

// Whatever the wrapping did, the names themselves must survive it: a network that is on the screen
// in one piece is what makes the screen worth showing.
static bool names_present(const char *json, const char *const *names, int count) {
    for (int i = 0; i < count; i++) if (!strstr(json, names[i])) return false;
    return true;
}

int main(void) {
    if (!font_init(font_blob, font_blob_size)) { printf("FAIL font_init\n"); return 1; }
    static char buf[3072];

    // A quiet room: three short names, no wrapping needed, one row each.
    {
        const char *body = ">Trying Home\nSaved: Home · Office\nNearby: Home · Office · Pixel";
        size_t n = builtin_frame_json(BUILTIN_WIFI_SETUP, buf, sizeof buf, "TVTOP-A145", body);
        CHECK(n > 0);
        text_op_t ops[32];
        int t = text_ops(buf, ops, 32);
        CHECK_MSG(t == 7, "quiet room: %d text ops, expected 7 (title, 3 body, 3 AP lines)", t);
        check_fits("quiet room", buf, 672);
    }

    // A busy room: long names that cannot possibly fit on one row.
    {
        static const char *const names[] = { "BTWholeHome-5G-Guest", "VM8872140-Upstairs",
                                             "SKYQ9F3A-Living-Room", "EE-Hub-2G-Spare",
                                             "Hotel-Guest-Wireless", "TALKTALK5AB2C9" };
        char body[420];
        int n = snprintf(body, sizeof body, ">None of your networks is in range\nSaved: %s · %s\nNearby: ",
                         names[0], names[1]);
        for (int i = 0; i < 6; i++)
            n += snprintf(body + n, sizeof body - (size_t)n, "%s%s", i ? " · " : "", names[i]);
        CHECK(builtin_frame_json(BUILTIN_WIFI_SETUP, buf, sizeof buf, "TVTOP-A145", body) > 0);
        check_fits("busy room, AP up", buf, 672);
        CHECK(names_present(buf, names, 6));
        text_op_t ops[32];
        // Three logical lines that have to become more than three rows, or nothing wrapped.
        CHECK(text_ops(buf, ops, 32) > 7);

        // The same body before the AP is up: more room, so nothing is dropped there either.
        CHECK(builtin_frame_json(BUILTIN_WIFI_SETUP, buf, sizeof buf, "", body) > 0);
        check_fits("busy room, still searching", buf, 672);
        CHECK(names_present(buf, names, 6));

        CHECK(builtin_frame_json(BUILTIN_NO_INTERNET, buf, sizeof buf, names[0], body) > 0);
        check_fits("no internet", buf, 672);
    }

    // One unbroken word wider than the screen: a 32-character SSID is legal, and hard-cutting it
    // is better than drawing it off both edges. It must still make progress, not loop.
    {
        const char *body = "Nearby: ABCDEFGHIJKLMNOPQRSTUVWXYZ012345WWWWWWWWWWWWWWWWWWWWWWWWWWWWWWWW";
        CHECK(builtin_frame_json(BUILTIN_WIFI_SETUP, buf, sizeof buf, "TVTOP-A145", body) > 0);
        check_fits("one long word", buf, 672);
    }

    // The fixed screens are written by hand and must fit as written.
    {
        CHECK(builtin_frame_json(BUILTIN_PROVISION, buf, sizeof buf, "TVTOP-A145", "http://192.168.4.1") > 0);
        check_fits("provision", buf, 672);
        CHECK(builtin_frame_json(BUILTIN_CONNECTING, buf, sizeof buf, "Hotel-Guest-Wireless", NULL) > 0);
        check_fits("connecting", buf, 672);
        CHECK(builtin_frame_json(BUILTIN_REGISTERING, buf, sizeof buf, NULL, NULL) > 0);
        check_fits("registering", buf, 672);
    }

    printf(failures ? "test_builtin: %d failure(s)\n" : "test_builtin: OK\n", failures);
    return failures ? 1 : 0;
}
